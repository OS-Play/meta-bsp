## conf/layer.conf
```bitbake
# We have a conf and classes directory, add to BBPATH
BBPATH .= ":${LAYERDIR}"

# We have recipes-* directories, add to BBFILES
BBFILES += "${LAYERDIR}/recipes-*/*/*.bb \
            ${LAYERDIR}/recipes-*/*/*.bbappend"

BBFILE_COLLECTIONS += "playos-bsp"
BBFILE_PATTERN_playos-bsp = "^${LAYERDIR}/"
BBFILE_PRIORITY_playos-bsp = "6"

LAYERDEPENDS_playos-bsp = "meson"
LAYERSERIES_COMPAT_playos-bsp = "kirkstone"

BBMASK += "/meta-meson/recipes-kernel/linux-firmware/.*\.bbappend"
```

## conf/machine/playos-kvim.conf
```bitbake
require conf/machine/khadas-vim.conf
require include/playos.inc

IMAGE_INSTALL = "\
    linux-firmware-bcm43430-kvim \
    linux-firmware-amlogic-vdec \
    "
```
